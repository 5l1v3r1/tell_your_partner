#include "ESP8266WiFi.h"
#include "PubSubClient.h"
#include <SPI.h>
#include <Wire.h>
#include <Adafruit_GFX.h>
#include <Adafruit_SSD1306.h>
#include <Adafruit_NeoPixel.h>

const unsigned char attention [] PROGMEM = {
  // 'ATTENTION, 64x48px
  0x00, 0x00, 0x00, 0x00, 0x00, 0x00, 0x00, 0x00, 0x00, 0x00, 0x00, 0x00, 0x00, 0x00, 0x00, 0x00, 
  0x00, 0x00, 0x00, 0x00, 0x00, 0x00, 0x00, 0x00, 0x00, 0x00, 0x00, 0x3f, 0xfe, 0x00, 0x00, 0x00, 
  0x00, 0x00, 0x00, 0xe0, 0x03, 0x80, 0x00, 0x00, 0x00, 0x00, 0x01, 0xc0, 0x08, 0xc0, 0x00, 0x00, 
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  0x00, 0x00, 0x00, 0x00, 0x00, 0x00, 0x00, 0x00, 0x00, 0x00, 0x00, 0x00, 0x00, 0x00, 0x00, 0x00
};

const unsigned char love [] PROGMEM = {
  // 'LOVE, 64x48px
  0x00, 0x00, 0x00, 0x00, 0x00, 0x00, 0x00, 0x00, 0x00, 0x00, 0x00, 0x00, 0x00, 0x00, 0x00, 0x00, 
  0x00, 0x00, 0x00, 0x00, 0x00, 0x00, 0x00, 0x00, 0x00, 0x00, 0x00, 0x00, 0x00, 0x00, 0x00, 0x00, 
  0x00, 0x00, 0x00, 0x00, 0x00, 0x00, 0x00, 0x00, 0x00, 0x00, 0x00, 0x00, 0x00, 0x00, 0x00, 0x00, 
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  0x00, 0x00, 0x00, 0x00, 0x00, 0x00, 0x00, 0x00, 0x00, 0x00, 0x00, 0x00, 0x00, 0x00, 0x00, 0x00
};

const unsigned char question [] PROGMEM = {
  // 'QUESTION, 64x48px
  0x00, 0x00, 0x00, 0x00, 0x00, 0x00, 0x00, 0x00, 0x00, 0x00, 0x00, 0x00, 0x00, 0x00, 0x00, 0x00, 
  0x00, 0x00, 0x00, 0x00, 0x00, 0x00, 0x00, 0x00, 0x00, 0x00, 0x00, 0x00, 0x00, 0x00, 0x00, 0x00, 
  0x00, 0x00, 0x00, 0x00, 0x00, 0x00, 0x00, 0x00, 0x00, 0x00, 0x01, 0xff, 0xff, 0x00, 0x00, 0x00, 
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  0x00, 0x00, 0x00, 0x00, 0x00, 0x00, 0x00, 0x00, 0x00, 0x00, 0x00, 0x00, 0x00, 0x00, 0x00, 0x00
};

const char* ssid = ""; //YOUR PARTNERS SSID
const char* password = ""; //YOUR PARTNERS WPA2 PASSKEY
const char* mqttServer = ""; //MQTT BROKER OF CHOICE
const int mqttPort = ; //MQTT PORT
const char* mqttTopic = ""; //MQTT TOPIC NAME
const char* likemesg = ""; //LIKEMESSAGE

const char* qstring = "/QUESTION"; //MQTT TRIGGERMESSAGE FOR QUESTIONMARK
const char* lstring = "/LOVE"; //MQTT TRIGGERMESSAGE FOR HEART
const char* atstring = "/ATTENTION"; //MQTT TRIGGERMESSAGE FOR EXCLAMATIONMARK

#define NUMPIXELS 7 //SET AMOUNT OF LEDS
#define PIN D4 //SET LED PIN

Adafruit_NeoPixel pixels = Adafruit_NeoPixel(NUMPIXELS, PIN, NEO_GRB + NEO_KHZ800);

WiFiClient espClient;
PubSubClient client(espClient);

#define OLED_RESET 0
Adafruit_SSD1306 display(OLED_RESET);

#if (SSD1306_LCDHEIGHT != 48)
#error("Height incorrect, please fix Adafruit_SSD1306.h!");
#endif

void callback(char* topic, byte* payload, unsigned int length) {
  for (int i=0; i<NUMPIXELS; i++) {
    pixels.setPixelColor(i, pixels.Color(150, 0, 0)); 
    pixels.show();
    delay(1000);
    }
  pixels.clear();
  Serial.print("Message arrived [");
  Serial.print(topic);
  Serial.print("] ");
  String message;
  for (int i = 0; i < length; i++) {
    message = message + (char)payload[i];  //Convert *byte to String
  }
  if (message == "/ATTENTION"){
    //FIRST BITMAP
    display.clearDisplay();
    display.drawBitmap( 0, 0, attention, 64, 48, WHITE);
    display.display();
    delay(10000);
  }
  else if (message == "/LOVE"){
    //SECOND BITMAP
    display.clearDisplay();
    display.drawBitmap( 0, 0, love, 64, 48, WHITE);
    display.display();
    delay(10000);
  }
  else if (message == "/QUESTION"){
    display.clearDisplay();
    display.drawBitmap( 0, 0, question, 64, 48, WHITE);
    display.display();
    delay(10000);
  }
  else {
  for (int i = 0; i < length; i++) {
    Serial.print((char)payload[i]);
  }
  Serial.println();

  String message = (char*)payload; 
  display.clearDisplay();
  display.setTextSize(1);
  display.setTextColor(WHITE);
  display.setCursor(0,0);
  if ((char)payload[0]) {
    display.clearDisplay();
    display.setTextColor(WHITE);
    display.setTextSize(1);
    display.setCursor(0,0);
    // print the message we get from mqtt
    display.print(message);
  // if payload = 0, using this to clear the line
  } else if ((char)payload[0] == '0') {
    display.clearDisplay();
    display.setTextColor(BLACK);
    display.setTextSize(1);
    display.setCursor(0,0); 
    display.print("....................."); 
  }
  }
}

void reconnect() {
  // Loop until we're reconnected
  while (!client.connected()) {
    Serial.print("Attempting MQTT connection...");
    // Attempt to connect
    if (client.connect("ESP8266Client")) {
      client.subscribe(mqttTopic);
    } else {
      Serial.print("failed, rc=");
      Serial.print(client.state());
      Serial.println(" try again in 5 seconds");
      // Wait 5 seconds before retrying
      delay(5000);
    }
  }
}

void setup() {
  pixels.begin();
  //Initialize Serial comm for Debugging
  Serial.begin(115200);
  //Connecting from here!
  WiFi.begin(ssid, password);
  while (WiFi.status() != WL_CONNECTED)
  {
    //Connection procedure
    delay(500);
    Serial.print("..");
  }
  //Connection established!
  Serial.println("");
  Serial.println("WiFi connection Successful");
  Serial.print("The IP Address of your D1 Mini Module is: ");
  Serial.print(WiFi.localIP());// Print the IP address
  //Connect to MQTT BROKER
  client.setServer(mqttServer, mqttPort);
  client.setCallback(callback);
  while (!client.connected()) {
    Serial.println("");
    Serial.println("Connecting to MQTT...");
    if (client.connect("ESP8266Client")) {
      Serial.println("connected"); 
    } else {
      Serial.print("failed with state ");
      Serial.print(client.state());
      delay(2000);
    }
  }
  //Initialize display
  display.begin(SSD1306_SWITCHCAPVCC, 0x3C);  display.display();
  delay(2000);
}

void fade_and_publish() {
  pixels.clear();
  uint16_t i, j;

  for (j = 255; j > 45; j--) {
    for (i = 0; i < pixels.numPixels(); i++) {
      pixels.setPixelColor(i, 0, 0, j);
    }
    pixels.show();
    delay(10);
  }
  delay(1500);

  for (j = 45; j < 255; j++) {
    for (i = 0; i < pixels.numPixels(); i++) {
      pixels.setPixelColor(i, 0, 0, j);
    }
    pixels.show();
    delay(10);
  }
}

void loop()
{
  if (digitalRead(D3) == LOW){
    client.publish(mqttTopic, likemesg, true);
    fade_and_publish();
  }
  if (!client.connected()) {
    reconnect();
  }
  client.loop();
  display.display();
}
